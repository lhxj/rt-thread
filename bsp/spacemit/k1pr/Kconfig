## bsp/spacemit/k1pr/Kconfig
```kconfig
mainmenu "RT-Thread Project Configuration (myk1)"

BSP_DIR := .
RTT_DIR := ../../..
PKGS_DIR := packages

SOC_DM_DIR := $BSP_DIR/../dm/

# 引入厂家通用的 DM 驱动开关
source "$(SOC_DM_DIR)/Kconfig"
# 引入 RT-Thread 内核和组件的开关
source "$(RTT_DIR)/Kconfig"
# 引入在线软件包的开关（osource 表示找不到也不报错）
osource "$PKGS_DIR/Kconfig"

config SOC_SPACEMIT_MYK1
    bool "Spacemit myK1 learning BSP"
    select ARCH_RISCV # 选中我，就必须使用 RISC-V 架构代码
    select ARCH_CPU_64BIT # 选中我，就把 CPU 设为 64 位模式
    select ARCH_USING_RISCV_COMMON64 # 选中我，就去用 libcpu 下的通用 64 位代码
    select RT_USING_COMPONENTS_INIT
    select RT_USING_USER_MAIN
    select RT_USING_CACHE
    select ARCH_MM_MMU # 选中我，自动开启 MMU 支持
    select ARCH_REMAP_KERNEL
    default y
```
